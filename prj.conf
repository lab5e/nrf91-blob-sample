## CMakeLists.txt
```
# SPDX-License-Identifier: Apache-2.0

cmake_minimum_required(VERSION 3.20.0)

find_package(Zephyr REQUIRED HINTS $ENV{ZEPHYR_BASE})
project(nrf91_span_blob)

target_sources(app PRIVATE src/main.c src/http.c)
```

## prj.conf
```kconfig
CONFIG_NETWORKING=y
CONFIG_NET_SOCKETS=y
CONFIG_NET_SOCKETS_POSIX_NAMES=y
CONFIG_NET_NATIVE=n

CONFIG_HEAP_MEM_POOL_SIZE=4096
CONFIG_MAIN_STACK_SIZE=4096

CONFIG_LTE_LINK_CONTROL=y
CONFIG_LTE_AUTO_INIT_AND_CONNECT=y
CONFIG_PDN=y
CONFIG_PDN_DEFAULTS_OVERRIDE=y
CONFIG_PDN_DEFAULT_APN="mda.lab5e"
CONFIG_NEWLIB_LIBC=y
```

## src/main.c
```c
/*
 * This is a modified version of the https_client sample in the nRF SDK.
 * There's no HTTP client here, just raw sockets.
 */

#include "http.h"
#include <modem/lte_lc.h>
#include <zephyr/kernel.h>

#define SPAN_PORT 80
#define SPAN_HOST "172.16.15.14"

#define BUF_SIZE 512

static char data_buf[BUF_SIZE];

#define PAYLOAD_SIZE (512 * 100)
void main(void) {
  lte_lc_connect();
  printk("HTTPS client sample started\n\r");
  http_request_t req;
  if (!http_post("/microblobber/service", &req)) {
    printk("Error creating request\n");
    goto clean_up;
  }

  http_header_content_type(&req, "application/binary");
  http_header_content_size(&req, PAYLOAD_SIZE);

  printf("Sending payload...\n");
  /* We'll generate just some bytes here and send them. If you are slightly */
  for (int i = 0; i < PAYLOAD_SIZE;) {
    for (int j = 0; j < BUF_SIZE; j++) {
      data_buf[j] = (char)(i % 0xff);
    }
    if (http_payload(&req, data_buf, BUF_SIZE)) {
      goto clean_up;
    }
    i += BUF_SIZE;
    printk("Sent %d of %d bytes\n", i, PAYLOAD_SIZE);
  }

  printk("Status: %d\n", http_result(&req));

clean_up:
  printk("Clean up\n");
  http_close(&req);

  printk("Power off LTE modem\n");
  lte_lc_power_off();
}
```

## src/http.c
```c
#include "http.h"
#include <zephyr/kernel.h>
#define BUF_SZ 256
static char tmpbuf[BUF_SZ];
static char headerbuf[BUF_SZ];

static int send_header(int fd, const char *header, const char *value) {
  sprintf(headerbuf, "%s: %s\r\n", header, value);
  int ret = send(fd, headerbuf, strlen(headerbuf), 0);
  if (ret != strlen(headerbuf)) {
    return -1;
  }
  return 0;
}

bool http_post(const char *path, http_request_t *req) {
  struct addrinfo hints = {
      .ai_family = AF_INET,
      .ai_socktype = SOCK_STREAM,
  };
  int err = getaddrinfo(SPAN_HOST, NULL, &hints, &req->addr);
  if (err) {
    return false;
  }

  ((struct sockaddr_in *)req->addr->ai_addr)->sin_port = htons(SPAN_PORT);

  int fd = socket(AF_INET, SOCK_STREAM, IPPROTO_TCP);
  if (fd == -1) {
    return false;
  }
  req->fd = fd;
  req->has_content = false;
  req->has_length = false;

  err = connect(fd, req->addr->ai_addr, sizeof(struct sockaddr_in));
  if (err) {
    close(fd);
    return false;
  }

  const char *post_path = path;
  if (strcmp(path, "") == 0) {
    post_path = "/";
  }
  // Send POST header
  sprintf(tmpbuf, "POST %s HTTP/1.1\r\n", post_path);
  err = send(fd, tmpbuf, strlen(tmpbuf), 0);
  if (err < 0) {
    close(fd);
    return false;
  }
  // Send Host and Connection header
  if (send_header(fd, "Connection", "close")) {
    close(fd);
    return false;
  }
  if (send_header(fd, "Host", "span")) {
    close(fd);
    return false;
  }
  return true;
}

int http_header_content_type(http_request_t *req, const char *mime_type) {
  return send_header(req->fd, "Content-Type", mime_type);
}

int http_header_content_size(http_request_t *req, const size_t sz) {
  req->has_length = true;
  sprintf(tmpbuf, "%d", sz);

  return send_header(req->fd, "Content-Length", tmpbuf);
}

int http_payload(http_request_t *req, const uint8_t *buf, const size_t sz) {
  if (!req->has_length) {
    return -1;
  }
  if (!req->has_content) {
    // Send newline before content
    int err = send(req->fd, "\r\n", 2, 0);
    if (err != 2) {
      return err;
    }
  }
  req->has_content = true;

  size_t remaining_size = sz;
  do {
    void *send_buf = buf;
    int sent = send(req->fd, send_buf, remaining_size, 0);
    if (sent < 0) {
      return sent;
    }
    remaining_size -= sent;
    send_buf += sent;
  } while (remaining_size > 0);
  return 0;
}

int http_result(http_request_t *req) {
  int bytes = 0;
  int status = 0;
  do {
    bytes = recv(req->fd, &tmpbuf, BUF_SZ, 0);
    if (bytes < 0) {
      return status;
    }
    // The response is HTTP/1.1 [status code] [message]
    // This is quite ugly but it works.
    if (bytes > 12 && status == 0) {
      status += 100 * (tmpbuf[9] - '0');
      status += 10 * (tmpbuf[10] - '0');
      status += (tmpbuf[11] - '0');
    }
  } while (bytes != 0 /* peer closed connection */);
  return status;
}

void http_close(http_request_t *req) {
  close(req->fd);
  freeaddrinfo(req->addr);
}
```

## src/http.h
```c
#pragma once
#include <stdio.h>
#include <zephyr/net/socket.h>

/**
 * This is a *very* simple tool class to write a HTTP request. The protocol
 * itself is as simple as they get. The client connects and sends
 *
 * POST [path] HTTP/1.1
 * [Header]: [Value]
 * [Header]: [Value]
 * [ ... repeated headers ... ]
 *
 * [binary payload]
 *
 * The server will then respond with
 * [three-digit status code] [status message]
 * [Response headers]
 *
 * If the Connection: close header is sent by the client the server will then
 * close the connection. The Host: [host name] header is required in HTTP/1.1.
 * The length of the payload is set by the client via the Content-Length header.
 *
 * These functions doesn't do a lot of error checking, it's just a wrapper on
 * top of the socket to write the headers and is a very naive implementation.
 *
 * For production code I'd recommend looking into adapting the source at
 * https://github.com/zephyrproject-rtos/zephyr/blob/main/subsys/net/lib/http/http_client.c
 * (it's not supported in nRF Connect SDK.. .yet)
 */

#define SPAN_PORT 80
#define SPAN_HOST "172.16.15.14"

typedef struct {
  int fd;
  struct addrinfo *addr;
  bool has_content;
  bool has_length;
} http_request_t;

/**
 * Start a HTTP POST request. This creates a new socket, connects to the server
 * and writes a few standard headers.
 *
 * @return false on error
 */
bool http_post(const char *path, http_request_t *req);

/**
 * Set content type for payload
 *
 * @return 0 on sucess, errno on error
 */
int http_header_content_type(http_request_t *req, const char *mime_type);

/**
 * Set size of payload
 *
 * @return 0 on sucess, errno on error
 */
int http_header_content_size(http_request_t *req, const size_t sz);

/**
 * Send payload
 *
 * @return 0 on sucess, errno on error
 */
int http_payload(http_request_t *req, const uint8_t *buf, const size_t sz);

/**
 * Read the result of the request
 *
 * @return HTTP status code 2xx, 3xx, 4xxx...
 */
int http_result(http_request_t *req);

/**
 * Close the request
 */
void http_close(http_request_t *req);
```
